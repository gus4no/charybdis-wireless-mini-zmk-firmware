#include <input/processors.dtsi>
#include <dt-bindings/zmk/input_transform.h>

&zip_temp_layer {
  require-prior-idle-ms=<800>;
};

&trackball_listener {
    /* base processor chain on all layers */
    input-processors = <
      &zip_temp_layer 3 500  /* MOUSE layer (layer 3) */
    >;


    /* scroll override */
    scroller: scroller {
        layers           = <4>;  /* SCROLL layer */
        input-processors = <
            &zip_xy_scaler 1 30                              // Scales the scroll speed
            &zip_xy_to_scroll_mapper                         // Converts XY movement to scroll events
            &zip_scroll_transform (INPUT_TRANSFORM_Y_INVERT) // Inverts the scroll direction
        >;
    };

    /* slow-pointer override */
    slow_pointer: slow_pointer {
        layers           = <5>;  /* SLOW layer */
        input-processors = <&zip_xy_scaler 2 6>;
    };
};

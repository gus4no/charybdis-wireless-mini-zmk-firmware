#define AS(keycode) &as LS(keycode) keycode     // Autoshift Macro

/ {
  behaviors {
    skcaps: sticky_keys_double_tap_caps {
      compatible = "zmk,behavior-tap-dance";
      #binding-cells = <0>;
      tapping-term-ms = <250>;
      bindings = <&sk LSFT>, <&kp CAPSLOCK>;
    };

    as: auto_shift {
      compatible = "zmk,behavior-hold-tap";
      #binding-cells = <2>;
      tapping-term-ms = <150>;
      quick-tap-ms = <0>;
      flavor = "tap-preferred";
      bindings = <&kp>, <&kp>;
    };
  };
};

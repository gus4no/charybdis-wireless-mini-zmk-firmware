/ {
  macros {
      meh: meh {
        compatible = "zmk,behavior-macro";
        #binding-cells = <0>;
        bindings = <&macro_press &kp LCTRL &kp LALT &kp LSHFT
                    &macro_pause_for_release
                    &macro_release &kp LCTRL &kp LALT &kp LSHFT>;
    };
  };
};
